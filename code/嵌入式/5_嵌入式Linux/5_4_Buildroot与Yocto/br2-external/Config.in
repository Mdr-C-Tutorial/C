## code/嵌入式/5_嵌入式Linux/5_4_Buildroot与Yocto/br2-external/Config.in
```kconfig
source "$BR2_EXTERNAL_MDR_PATH/package/sensord/Config.in"
source "$BR2_EXTERNAL_MDR_PATH/package/mdr-fifo/Config.in"
```

## code/嵌入式/5_嵌入式Linux/5_4_Buildroot与Yocto/br2-external/configs/mdr_qemu_defconfig
```kconfig
# MDR 的 QEMU 板级配置（Buildroot 2026.02 LTS）
#
# 用法：在一个干净的构建目录里
#   make BR2_EXTERNAL=/path/to/br2-external mdr_qemu_defconfig
#   make
#
# 生成的映像在 output/images/ 下，用 start-qemu.sh 启动。

# 架构与工具链
BR2_arm=y
BR2_cortex_a9=y
BR2_TOOLCHAIN_BUILDROOT_GLIBC=y
BR2_TOOLCHAIN_BUILDROOT_CXX=y

# 系统
BR2_TARGET_GENERIC_HOSTNAME="mdr"
BR2_TARGET_GENERIC_ISSUE="Welcome to MDR"
BR2_TARGET_GENERIC_ROOT_PASSWD=""
BR2_SYSTEM_DHCP=""

# 内核
BR2_LINUX_KERNEL=y
BR2_LINUX_KERNEL_CUSTOM_VERSION=y
BR2_LINUX_KERNEL_CUSTOM_VERSION_VALUE="6.18"
BR2_LINUX_KERNEL_USE_DEFCONFIG=y
BR2_LINUX_KERNEL_DEFCONFIG="vexpress_defconfig"
BR2_LINUX_KERNEL_DTS_SUPPORT=y
BR2_LINUX_KERNEL_INTREE_DTS_NAME="arm/vexpress-v2p-ca9"
BR2_LINUX_KERNEL_INSTALL_TARGET=y
BR2_LINUX_KERNEL_NEEDS_HOST_OPENSSL=y

# 根文件系统
BR2_TARGET_ROOTFS_EXT2=y
BR2_TARGET_ROOTFS_EXT2_4=y
BR2_TARGET_ROOTFS_TAR=y
BR2_ROOTFS_OVERLAY="$(BR2_EXTERNAL_MDR_PATH)/board/mdr/rootfs-overlay"
BR2_ROOTFS_POST_BUILD_SCRIPT="$(BR2_EXTERNAL_MDR_PATH)/board/mdr/post-build.sh"

# 系统工具
BR2_PACKAGE_BUSYBOX=y
BR2_PACKAGE_BUSYBOX_SHOW_OTHERS=y
BR2_PACKAGE_STRACE=y
BR2_PACKAGE_DROPBEAR=y
BR2_PACKAGE_KMOD=y

# 网络与设备管理
BR2_PACKAGE_IPROUTE2=y
BR2_PACKAGE_IFUPDOWN_SCRIPTS=y

# MDR 自己的软件包
BR2_PACKAGE_SENSORD=y
BR2_PACKAGE_MDR_FIFO=y
```

## code/嵌入式/5_嵌入式Linux/5_4_Buildroot与Yocto/br2-external/package/mdr-fifo/Config.in
```kconfig
config BR2_PACKAGE_MDR_FIFO
	bool "mdr-fifo"
	depends on BR2_LINUX_KERNEL
	help
	  5.7 的示例字符设备：一个纯软件的先进先出缓冲区。
	  加载后出现 /dev/mdr_fifo。

	  https://github.com/Mdr-C-Tutorial/C
```

## code/嵌入式/5_嵌入式Linux/5_4_Buildroot与Yocto/br2-external/package/sensord/Config.in
```kconfig
config BR2_PACKAGE_SENSORD
	bool "sensord"
	depends on BR2_USE_MMU
	help
	  MDR 的传感器轮询服务。周期读取数据源，往标准输出打印
	  一行统计；SIGHUP 重载配置，SIGTERM 干净退出。

	  https://github.com/Mdr-C-Tutorial/C
```

## code/嵌入式/5_嵌入式Linux/5_4_Buildroot与Yocto/meta-mdr/conf/layer.conf
```bitbake
# 层配置：build/conf/bblayers.conf 里加上这一层的路径后生效。
BBPATH .= ":${LAYERDIR}"
BBFILES += "${LAYERDIR}/recipes-*/*/*.bb \
            ${LAYERDIR}/recipes-*/*/*.bbappend"

BBFILE_COLLECTIONS += "meta-mdr"
BBFILE_PATTERN_meta-mdr = "^${LAYERDIR}/"
BBFILE_PRIORITY_meta-mdr = "10"

LAYERDEPENDS_meta-mdr = "core"
LAYERSERIES_COMPAT_meta-mdr = "scarthgap wrynose"
```

## code/嵌入式/7_综合实践/7_4_嵌入式Linux驱动与应用/br2-external/Config.in
```kconfig
source "$BR2_EXTERNAL_MDR_PATH/package/coremqtt/Config.in"
source "$BR2_EXTERNAL_MDR_PATH/package/mdr-imu/Config.in"
source "$BR2_EXTERNAL_MDR_PATH/package/imud/Config.in"
```

## code/嵌入式/7_综合实践/7_4_嵌入式Linux驱动与应用/br2-external/configs/mdr_qemu_defconfig
```kconfig
# MDR 的 IMU 产品，QEMU vexpress-a9（无硬件时的路线）
#
# 这台机器上没有 MPU6050 的 I2C 总线，驱动用 i2c-stub 做冒烟测试；
# 中断路径不可用，驱动退化为"按需读取"。
#
#   make BR2_EXTERNAL=/path/to/7_4_.../br2-external mdr_qemu_defconfig
#   make
#   ./output/images/start-qemu.sh

# 架构：Cortex-A9，32 位 armhf（与 5.4 的 QEMU 平台一致）
BR2_arm=y
BR2_cortex_a9=y
BR2_TOOLCHAIN_BUILDROOT_GLIBC=y

# 系统
BR2_TARGET_GENERIC_HOSTNAME="mdr-qemu"
BR2_TARGET_GENERIC_ISSUE="MDR IMU on QEMU"
BR2_TARGET_GENERIC_ROOT_PASSWD=""
BR2_SYSTEM_DHCP=""

# 内核
BR2_LINUX_KERNEL=y
BR2_LINUX_KERNEL_CUSTOM_VERSION=y
BR2_LINUX_KERNEL_CUSTOM_VERSION_VALUE="6.18"
BR2_LINUX_KERNEL_USE_DEFCONFIG=y
BR2_LINUX_KERNEL_DEFCONFIG="vexpress_defconfig"
BR2_LINUX_KERNEL_DTS_SUPPORT=y
BR2_LINUX_KERNEL_INTREE_DTS_NAME="arm/vexpress-v2p-ca9"
BR2_LINUX_KERNEL_INSTALL_TARGET=y
BR2_LINUX_KERNEL_NEEDS_HOST_OPENSSL=y

# i2c-stub 与 i2c-dev 是冒烟测试的前提，编进内核
BR2_LINUX_KERNEL_CONFIG_FRAGMENT_FILES="$(BR2_EXTERNAL_MDR_PATH)/board/mdr/qemu-stub.fragment"

# 根文件系统
BR2_TARGET_ROOTFS_EXT2=y
BR2_TARGET_ROOTFS_EXT2_4=y
BR2_TARGET_ROOTFS_TAR=y
BR2_ROOTFS_OVERLAY="$(BR2_EXTERNAL_MDR_PATH)/board/mdr/rootfs-overlay-qemu"
BR2_ROOTFS_POST_BUILD_SCRIPT="$(BR2_EXTERNAL_MDR_PATH)/board/mdr/post-build.sh"

# 系统工具
BR2_PACKAGE_BUSYBOX=y
BR2_PACKAGE_BUSYBOX_SHOW_OTHERS=y
BR2_PACKAGE_KMOD=y
BR2_PACKAGE_I2C_TOOLS=y

# MDR 自己的包
BR2_PACKAGE_COREMQTT=y
BR2_PACKAGE_MDR_IMU=y
BR2_PACKAGE_IMUD=y
```

## code/嵌入式/7_综合实践/7_4_嵌入式Linux驱动与应用/br2-external/configs/mdr_stm32mp157_defconfig
```kconfig
# MDR 的 IMU 产品，目标板 STM32MP157 Discovery（DK1/DK2）
#
#   make BR2_EXTERNAL=/path/to/7_4_.../br2-external mdr_stm32mp157_defconfig
#   make
#
# 输出在 output/images/ 下：zImage、stm32mp157a-dk1.dtb、rootfs.ext4、
# sdcard.img。烧到 SD 卡后从板子启动即可。

# 架构：Cortex-A7，32 位 armhf
BR2_arm=y
BR2_cortex_a7=y
BR2_TOOLCHAIN_BUILDROOT_GLIBC=y
BR2_TOOLCHAIN_BUILDROOT_CXX=y

# 系统
BR2_TARGET_GENERIC_HOSTNAME="mdr-imu"
BR2_TARGET_GENERIC_ISSUE="MDR IMU gateway"
BR2_TARGET_GENERIC_ROOT_PASSWD="mdr"
BR2_SYSTEM_DHCP="eth0"

# 内核：ST 的 DK 板设备树，6.18 LTS
BR2_LINUX_KERNEL=y
BR2_LINUX_KERNEL_CUSTOM_VERSION=y
BR2_LINUX_KERNEL_CUSTOM_VERSION_VALUE="6.18"
BR2_LINUX_KERNEL_USE_DEFCONFIG=y
BR2_LINUX_KERNEL_DEFCONFIG="multi_v7"
BR2_LINUX_KERNEL_DTS_SUPPORT=y
BR2_LINUX_KERNEL_INTREE_DTS_NAME="st/stm32mp157a-dk1 st/stm32mp157c-dk2"
BR2_LINUX_KERNEL_NEEDS_HOST_OPENSSL=y
BR2_LINUX_KERNEL_INSTALL_TARGET=y

# 根文件系统
BR2_TARGET_ROOTFS_EXT2=y
BR2_TARGET_ROOTFS_EXT2_4=y
BR2_TARGET_ROOTFS_EXT2_SIZE="256M"
BR2_TARGET_ROOTFS_TAR=y
BR2_ROOTFS_OVERLAY="$(BR2_EXTERNAL_MDR_PATH)/board/mdr/rootfs-overlay"
BR2_ROOTFS_POST_BUILD_SCRIPT="$(BR2_EXTERNAL_MDR_PATH)/board/mdr/post-build.sh"

# 系统工具
BR2_PACKAGE_BUSYBOX=y
BR2_PACKAGE_BUSYBOX_SHOW_OTHERS=y
BR2_PACKAGE_KMOD=y
BR2_PACKAGE_DROPBEAR=y
BR2_PACKAGE_STRACE=y
BR2_PACKAGE_I2C_TOOLS=y

# 网络
BR2_PACKAGE_IPROUTE2=y
BR2_PACKAGE_IFUPDOWN_SCRIPTS=y
BR2_PACKAGE_DHCPCD=y

# MDR 自己的包
BR2_PACKAGE_COREMQTT=y
BR2_PACKAGE_MDR_IMU=y
BR2_PACKAGE_IMUD=y
```

## code/嵌入式/7_综合实践/7_4_嵌入式Linux驱动与应用/br2-external/package/coremqtt/Config.in
```kconfig
config BR2_PACKAGE_COREMQTT
	bool "coreMQTT"
	help
	  FreeRTOS 的 MQTT 3.1.1 客户端库，只装头文件与静态库。
	  imud 用它发布遥测；7.3 的固件用的是同一个库。

	  https://github.com/FreeRTOS/coreMQTT
```

## code/嵌入式/7_综合实践/7_4_嵌入式Linux驱动与应用/br2-external/package/imud/Config.in
```kconfig
config BR2_PACKAGE_IMUD
	bool "imud"
	depends on BR2_USE_MMU
	depends on BR2_TOOLCHAIN_HAS_THREADS
	select BR2_PACKAGE_COREMQTT
	help
	  MDR 的 IMU 服务。读 /dev/mdr_imu 的定长样本，用互补滤波算倾角，
	  按周期把遥测发布到 MQTT 服务器；命令主题支持 rate。

	  https://github.com/Mdr-C-Tutorial/C
```

## code/嵌入式/7_综合实践/7_4_嵌入式Linux驱动与应用/br2-external/package/mdr-imu/Config.in
```kconfig
config BR2_PACKAGE_MDR_IMU
	bool "mdr-imu"
	depends on BR2_LINUX_KERNEL
	help
	  MPU6050 的字符设备驱动（7.4）。加载后出现 /dev/mdr_imu，
	  一次 read 交出一个带时间戳的定长样本；
	  /sys/class/misc/mdr_imu/ 下有 sample_rate 与 accel_range。

	  https://github.com/Mdr-C-Tutorial/C
```
